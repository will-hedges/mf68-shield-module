## boards/shields/mf68/Kconfig.defconfig
```kconfig
# Copyright (c) 2024 will-hedges <https://github.com/will-hedges>
# SPDX-License-Identifier: MIT

if SHIELD_MF68

config ZMK_KEYBOARD_NAME
    default "mf68"

endif
```

## boards/shields/mf68/Kconfig.shield
```kconfig
# Copyright (c) 2024 will-hedges <https://github.com/will-hedges>
# SPDX-License-Identifier: MIT

config SHIELD_MF68
    def_bool $(shields_list_contains,mf68)
    
```
